## bootloader/mx6sll-n249/board/kobo/mx6sllclarahd/Kconfig
```kconfig
if TARGET_MX6SLLKOBOCLARAHD

config SYS_BOARD
	default "mx6sllclarahd"

config SYS_VENDOR
	default "kobo"

config SYS_CONFIG_NAME
	default "mx6sllclarahd"

source "board/kobo/common/Kconfig"
endif
```

## bootloader/mx6sll-n249/board/kobo/mx6sltolinoshine3/Kconfig
```kconfig
if TARGET_MX6SLTOLINOSHINE3

config SYS_BOARD
	default "mx6sltolinoshine3"

config SYS_VENDOR
	default "kobo"

config SYS_CONFIG_NAME
	default "mx6sltolinoshine3"

source "board/kobo/common/Kconfig"
endif
```

## bootloader/mx6sll-n249/configs/mx6sllclarahd_defconfig
```kconfig
CONFIG_ARM=y
CONFIG_ARCH_MX6=y
CONFIG_SYS_TEXT_BASE=0x87800000
CONFIG_NR_DRAM_BANKS=1
CONFIG_SYS_MEMTEST_START=0x80000000
CONFIG_SYS_MEMTEST_END=0x88000000
CONFIG_ENV_SIZE=0x2000
CONFIG_ENV_OFFSET=0xC0000
CONFIG_MX6SLL=y
CONFIG_TARGET_MX6SLLKOBOCLARAHD=y
CONFIG_BLK=y
CONFIG_DM_GPIO=y
CONFIG_DM_MMC=y
CONFIG_DEFAULT_DEVICE_TREE="imx6sll-kobo-clarahd"
# CONFIG_CMD_BMODE is not set
CONFIG_SUPPORT_RAW_INITRD=y
CONFIG_SYS_EXTRA_OPTIONS="IMX_CONFIG=board/kobo/mx6sllclarahd/imximage.cfg"
CONFIG_BOARD_EARLY_INIT_F=y
CONFIG_HUSH_PARSER=y
CONFIG_CMD_BOOTZ=y
CONFIG_CMD_MEMTEST=y
CONFIG_CMD_GPIO=y
CONFIG_CMD_I2C=y
CONFIG_CMD_MMC=y
CONFIG_CMD_CACHE=y
CONFIG_CMD_EXT2=y
CONFIG_CMD_EXT4=y
CONFIG_CMD_EXT4_WRITE=y
CONFIG_CMD_FAT=y
CONFIG_CMD_FS_GENERIC=y
CONFIG_CMD_USB_MASS_STORAGE=y
CONFIG_OF_CONTROL=y
CONFIG_ENV_OVERWRITE=y
CONFIG_ENV_IS_IN_MMC=y
CONFIG_SYS_RELOC_GD_ENV_ADDR=y
CONFIG_BOUNCE_BUFFER=y
CONFIG_DM_I2C=y
CONFIG_FSL_USDHC=y
CONFIG_MTD=y
CONFIG_PINCTRL=y
CONFIG_PINCTRL_IMX6=y
CONFIG_DM_PMIC=y
CONFIG_DM_REGULATOR=y
CONFIG_DM_REGULATOR_FIXED=y
CONFIG_DM_REGULATOR_GPIO=y
CONFIG_MXC_UART=y
CONFIG_IMX_THERMAL=y
CONFIG_USB=y
CONFIG_DM_USB=y
CONFIG_CI_UDC=y
CONFIG_USB_GADGET=y
CONFIG_USB_GADGET_DOWNLOAD=y
CONFIG_USB_GADGET_VENDOR_NUM=0x18d1
CONFIG_USB_GADGET_PRODUCT_NUM=0x0d02
CONFIG_USB_FUNCTION_MASS_STORAGE=y
CONFIG_USB_FUNCTION_FASTBOOT=y
CONFIG_NET=n
CONFIG_FASTBOOT=y
CONFIG_CMD_FASTBOOT=y
CONFIG_LED=y
CONFIG_LED_GPIO=y
CONFIG_BUTTON=y
CONFIG_BUTTON_GPIO=y
CONFIG_KOBO_COMMON=y
CONFIG_SYS_PROMPT="kobo => "
```

## bootloader/mx6ull-n306/board/freescale/mx6sll_ntx/Kconfig
```kconfig
if TARGET_MX6SLL_NTX

config SYS_BOARD
	default "mx6sll_ntx"

config SYS_VENDOR
	default "freescale"

config SYS_CONFIG_NAME
	default "mx6sll_ntx"

endif
```

## bootloader/mx6ull-n306/board/freescale/mx6ull_ntx/Kconfig
```kconfig
if TARGET_MX6ULL_NTX

config SYS_BOARD
	default "mx6ull_ntx"

config SYS_VENDOR
	default "freescale"

config SYS_CONFIG_NAME
	default "mx6ull_ntx"

endif
```

## bootloader/mx6ull-n306/configs/mx6sll_ntx_lpddr2_512m_defconfig
```kconfig
CONFIG_SYS_EXTRA_OPTIONS="IMX_CONFIG=board/freescale/mx6sll_ntx/imximage_lpddr2_512M.cfg,LPDDR2_512M"
CONFIG_ARM=y
CONFIG_ARCH_MX6=y
CONFIG_TARGET_MX6SLL_NTX=y
CONFIG_CMD_GPIO=y
CONFIG_SYS_PROMPT="eBR-1A # "
```

## kernel/linux-2.6.31-kt/arch/arm/mach-mx5/Kconfig
```kconfig
if ARCH_MX5

config ARCH_MX51
	bool

config ARCH_MX53
	bool

config ARCH_MX50
	bool

config FORCE_MAX_ZONEORDER
    int "MAX_ORDER"
    default "13"

config MX5_OPTIONS
	bool
	default y
	select CPU_V7
	select USB_ARCH_HAS_EHCI
	select MXC_TZIC
	select DMABOUNCE

config MX5_MULTI_ARCH
	bool
	default y
	select RUNTIME_PHYS_OFFSET
	depends on ARCH_MX51
	depends on ARCH_MX50 || ARCH_MX53

config MACH_MX51_3DS
	bool "Support MX51 3-Stack platform"
	select ARCH_MX51
	help
	  Include support for MX51 3-Stack platform. This includes specific
	  configurations for the board and its peripherals.

config MACH_MX51_BABBAGE
	bool "Support MX51 BABBAGE platform"
	select ARCH_MX51
	help
	  Include support for MX51 Babbage platform. This includes specific
	  configurations for the board and its peripherals.

config MACH_MX53_EVK
	bool "Support MX53 EVK platform"
	select ARCH_MX53
	help
	  Include support for MX53 EVK platform. This includes specific
	  configurations for the board and its peripherals.

config MACH_MX50_ARM2
	bool "Support MX50 Armadillo2 platform"
	select ARCH_MX50
	help
	  Include support for MX50 EVK platform. This includes specific
	  configurations for the board and its peripherals.

config MACH_MX50_TEQUILA
	bool "Support MX50 Tequila Platform"
	select ARCH_MX50
	help
	  Include support for MX50 Tequila platform. This includes specific
	  configurations for the board and its peripherals.

config MACH_MX50_YOSHI
	bool "Support MX50 Yoshi platform"
	select ARCH_MX50
	help
	  Include support for MX50 Yoshi platform. This includes specific
	  configurations for the board and its peripherals.

config MACH_MX50_YOSHIME
	bool "Support MX50 Yoshime platform"
	select ARCH_MX50
	help
	  Include support for MX50 Yoshime platform. This includes specific
	  configurations for the board and its peripherals.

config MX50_YOSHI_SX5844
	tristate "SX5844 Acelerometer Device Driver"
	depends on MACH_MX50_YOSHI
	select HWMON
	default n
	help
	  This driver adds support for the 3-Axis, 8-bit Digital Accelerometer

config MX50_YOSHI_MMA8453
	tristate "MMA8453 Acelerometer Device Driver"
	depends on MACH_MX50_YOSHI
	select HWMON
	default n
	help
	  This driver adds support for the 3-Axis, 12-bit Digital Accelerometer

config MX50_YOSHIME_MMA8653
	tristate "MMA8653 Acelerometer Device Driver"
	depends on MACH_MX50_YOSHIME
	select HWMON
	default n
	help
	  This driver adds support for the 3-Axis, 10-bit Digital Accelerometer

config MX50_YOSHIME_PROXIMITY
	tristate "MX50 Yoshime Proximity Sensor Driver"
	depends on MACH_MX50_YOSHIME
	default n
	help
	  This driver adds support for yoshime proximity sensor

config MX50_YOSHI_SDCARD
	tristate "MX50 Yoshi SD Card support"
	depends on MACH_MX50_YOSHI
	default n

config MX50_YOSHI_ACCESSORY
	tristate "MX50 Yoshi Accessory Port support"
	depends on (MACH_MX50_YOSHI || MACH_MX50_TEQUILA || MACH_MX50_YOSHIME)
	default y

comment "MX5x Options:"

config MXC_SDMA_API
        bool "Use SDMA API"
        default y
        help
           This selects the Freescale MXC SDMA API.
           If unsure, say N.

config ARCH_MXC_HAS_NFC_V3
        bool "MXC NFC Hardware Version 3"
        depends on ARCH_MX5
        default y
        help
           This selects the Freescale MXC Nand Flash Controller Hardware Version 3
           If unsure, say N.

config ARCH_MXC_HAS_NFC_V3_2
        bool "MXC NFC Hardware Version 3.2"
        depends on ARCH_MXC_HAS_NFC_V3
        default y
        help
           This selects the Freescale MXC Nand Flash Controller Hardware Version 3.1
           If unsure, say N.

config SDMA_IRAM
	bool "Use Internal RAM for SDMA transfer"
	depends on MXC_SDMA_API
	help
	  Support Internal RAM as SDMA buffer or control structures

endif
```

## kernel/linux-2.6.31-kt/drivers/mxc/amd-gpu-lab126/Kconfig
```kconfig
#
# Bluetooth configuration
#

menu "MXC AMD GPU support"

config MXC_AMD_GPU_LAB126
	tristate "MXC AMD GPU support"
	depends on ARCH_MX35 || ARCH_MX51 || ARCH_MX53 || ARCH_MX50
	---help---
         Say Y to get the GPU driver support.

endmenu
```

## kernel/linux-2.6.31-kt/drivers/mxc/pmic/mc34708/Kconfig
```kconfig
#
# PMIC Modules configuration
#

config MXC_MC34708_ADC
	tristate "MC34708 ADC support"
	depends on MXC_PMIC_MC34708
	---help---
	This is the MC34708 ADC module driver. This module provides kernel API
	for the ADC system of MC34708.
	It controls also the touch screen interface.
	If you want MC34708 ADC support, you should say Y here

config MXC_MC34708_RTC
	tristate "MC34708 Real Time Clock (RTC) support"
	depends on MXC_PMIC_MC34708
	---help---
	This is the MC34708 RTC module driver. This module provides kernel API
	for RTC part of MC34708.
	If you want MC34708 RTC support, you should say Y here
config MXC_MC34708_BATTERY
	tristate "MC34708 Battery API support"
	depends on MXC_PMIC_MC34708
	---help---
	This is the MC34708 battery module driver. This module provides kernel API
	for battery control part of MC34708.
	If you want MC34708 battery support, you should say Y here
config MXC_MC34708_LIGHT
        tristate "MC34708 Light and Backlight support"
        depends on MXC_PMIC_MC34708
        ---help---
        This is the MC34708 Light module driver. This module provides kernel API
        for led and backlight control part of MC34708.
        If you want MC34708 Light support, you should say Y here
config MXC_MC34708_POWER
        tristate "MC34708 Power API support"
        depends on MXC_PMIC_MC34708
        ---help---
        This is the MC34708 power and supplies module driver. This module provides kernel API
        for power and regulator control part of MC34708.
        If you want MC34708 power support, you should say Y here
```

## kernel/linux-2.6.35.3-n905b/drivers/net/wireless/kobo_bcmdhd/Kconfig.rej
```kconfig
--- Kconfig-orig	2013-06-13 23:29:28.000000000 +0200
+++ Kconfig	2015-01-07 22:20:43.000000000 +0100
@@ -282,4 +282,6 @@
 source "drivers/net/wireless/wl12xx/Kconfig"
 source "drivers/net/wireless/zd1211rw/Kconfig"
 
+source "drivers/net/wireless/kobo_bcmdhd/Kconfig"
+
 endif # WLAN
```

## kernel/linux-2.6.35.3-spt1/drivers/misc/wwan_ctrl/Kconfig
```kconfig
config WWAN_CTRL
	bool "WWAN Control Driver"
	default y
	---help---
	 WWAN control driver.
```

## kernel/linux-2.6.35.3-spt1/fs/Kconfig.snsc
```kconfig
comment "SNSC related options"
	depends on SNSC

config SNSC_FS_FAT_BATCH_SYNC
	bool "Enable 'batch_sync' option for FAT"
	depends on SNSC && (MSDOS_FS || VFAT_FS)
	default y
	help
	  This option introduces an new option "batch_sync".

config SNSC_FS_FAT_BATCH_SYNC_DEFAULT_OPT
	bool "Do FAT of batch_sync option appointment in mounting it with a default."
	depends on SNSC_FS_FAT_BATCH_SYNC
	default y
	help
	  Do FAT of batch_sync option appointment in mounting it with a default.

config SNSC_FS_FAT_BATCH_DIRSYNC_DEFAULT_OPT
	bool "Do FAT of batch_dirsync option appointment in mounting it with a default."
	depends on SNSC_FS_FAT_BATCH_SYNC
	default n
	help
	  Do FAT of batch_dirsync option appointment in mounting it with a default.
```

## kernel/linux-2.6.35.3/drivers/net/wireless/kobo_bcmdhd/Kconfig
```kconfig
config KOBO_BCM_DHD
	tristate "Broadcom Dongle Host Driver on Kobo Mini"
	depends on WLAN && EXPERIMENTAL
	select FW_LOADER
	select WIRELESS_EXT
	select WEXT_PRIV
	---help---
	  This is an backported driver for the Broadcom bcm43362 SDIO WLAN chip found on Kobo Mini E-Book readers.
	  
	  Device firmware is required alongside this driver. You can download
	  the complete distribution (firmware and sourcecode) from https://github.com/kobolabs/Kobo-Reader/blob/master/hw/imx508/ntx/
	  (file bcm-dhd-falcon-5901132-03112011.tgz)

	      
config KOBO_BCM_DHD_FW_SELECTION
	bool "enable automatic selection of FW image"
	depends on KOBO_BCM_DHD
	---help---
	  There are 3 different FW images delivered with my Kobo in directory /lib/firmware/wc121 .
	  This patch appends the string ".WC121A2" to the default FW image pathname prior to 
	  download, if a chip with id 0xA962 has been detected.  It helped (at least on 
	  my Kobo) to get a self-compiled driver to work. However the original driver
	  works with both delivered FW images.
	  
	  If unsure say [Y]
	   
    
config KOBO_BCM_DHD_WIFI_DIRECT
	bool "enable support for Wifi-direct"
	depends on KOBO_BCM_DHD && CFG80211 && !BACKPORT_KERNEL_3_99
	---help---
	  Adds another compileable chunk of code from Broadcom to the module. Therefore it will get bigger.
	  Normal connectivity to APs should work also without it.
	  
	  If unsure say [N] 

    
config KOBO_BCM_DHD_DEBUG
	bool "DHD debugging"
	depends on KOBO_BCM_DHD
	---help---
	  BCM_DHD debugging messages. Choosing Y will result in additional debug
	  messages being saved to your kernel logs, which may help debug any
	  problems.
	  
	  If unsure say [N]  

    
config KOBO_BCM_DHD_DEVELOPING
	bool "implement the cfg80211 support"
	depends on KOBO_BCM_DHD && CFG80211 && BACKPORT_KERNEL_3_99
	---help---
	  There are errors in the code. Interface definition has been changed and this part of code would not compile.
	  Switch this on if you are a developer who would like to correct the cfg80211 implementation.
	  It adds the files wl_cfg80211.c and wl_cfgp2p.c to the module and tries to compile them.
	  This option is only avalable in linux-backport-driver environment.
	  
	  If unsure say [N]

    
config KOBO_BCM_DHD_STATIC_BUF
	bool "use static buffer"
	depends on KOBO_BCM_DHD 
	
	
```

## kernel/linux-4.1.15-n306/kernel/ntx/Kconfig
```kconfig
#
# NTX subsystem related configuration options
#

config NTX_TIMESTAMPS
	bool "NTX Timestamps mesurement Support"
	help
	  This option enables ntx_timestamp measurement support.
```
